## drivers/adsp_factory/Kconfig
```kconfig
#
# factory sensor drivers configuration
#
config ADSP_FACTORY
	tristate "MSM ADSP factory driver"
	default n
	help
	  This driver communicate with SSC DAEMON.
	  register each sensor device.
	  send selftest request using netlink.
	  receive test result using netlink.

config LSM6DSO_FACTORY
	tristate "factory test for SSC - LSM6DSO"
	default n
	help
	  lsm6dso factory driver.
	  provide sysfs for factory test.
	  request selftest to adsp_factory.
	  receive test result from adsp_factory.

config AK09918_FACTORY
	tristate "factory test for SSC - ak09918"
	default n
	help
	  ak09918 factory driver.
	  provide sysfs for factory test.
	  request selftest to adsp_factory.
	  receive test result from adsp_factory.

config LPS22HH_FACTORY
	tristate "factory test for SSC - lps22hh"
	default n
	help
	  lps22hh factory driver.
	  provide sysfs for factory test.
	  request selftest to adsp_factory.
	  receive test result from adsp_factory.

config TMD490X_FACTORY
	tristate "factory test for SSC - tmd490x"
	default n
	help
	  tmd490x factory driver.
	  provide sysfs for factory test.
	  request selftest to adsp_factory.
	  receive test result from adsp_factory.

config SUPPORT_TMD4906_FACTORY
	tristate "factory test for SSC - tmd4906"
	depends on TMD490X_FACTORY
	default n
	help
	  tmd4906 factory driver
	  provide sysfs for factory test.
	  request selftest to adsp_factory.
	  receive test result from adsp_factory.

config SUPPORT_PROX_AUTO_CAL
	tristate "Support Auto Calibration for proximity sensor - tmd490x"
	default n
	depends on TMD490X_FACTORY
	help
	  Support the Auto Calibration function in tmd490x.
	  provide sysfs for factory test.
	  request selftest to adsp_factory.
	  receive test result from adsp_factory.

config SUPPORT_HIDDEN_HOLE
	tristate "Support Hidden Hole function for proximity sensor"
	default n
	depends on ADSP_FACTORY
	help
	  Support the Hidden Hole function.
	  provide sysfs for factory test.
	  request selftest to adsp_factory.
	  receive test result from adsp_factory.

config SUPPORT_HIDDEN_HOLE_SUB
	tristate "Support Hidden Hole Sub function for proximity sensor"
	default n
	depends on ADSP_FACTORY
	help
	  Support the Hidden Hole Sub function.
	  provide sysfs for factory test.
	  request selftest to adsp_factory.
	  receive test result from adsp_factory.

config SLPI_MOTOR
	tristate "Sensors support motor"
	default n
	help
	  Support the motor state function
	  provide sysfs for factory test.
	  request selftest to adsp_factory.
	  receive test result from adsp_factory.

config SUPPORT_MOBEAM
	tristate "Sensors support mobeam"
	default n
	help
	  Support the mobeam
	  provide sysfs for factory test.
	  request selftest to adsp_factory.
	  receive test result from adsp_factory.

config SUPPORT_SUB_MOBEAM
	tristate "Sensors support sub mobeam"
	depends on SUPPORT_MOBEAM
	help
	  Support the sub mobeam
	  provide sysfs for factory test.
	  request selftest to adsp_factory.
	  receive test result from adsp_factory.

config SUPPORT_BHL_COMPENSATION_FOR_LIGHT_SENSOR
	tristate "Sensors support BHL compensation"
	default n
	help
	  Support BHL compensation for light sensor
	  provide sysfs for LCD service.
	  receive aor and brightness level from lcd driver.

config SUPPORT_BRIGHT_COMPENSATION_LUX
	tristate "Sensors support lux compensation based on brightness"
	default n
	help
	  Support lux compensation based on brightness
	  provide sysfs for LCD service.
	  receive aor and brightness level from lcd driver.

config SUPPORT_DUAL_6AXIS
	tristate "Sensors support dual 6axis"
	default n
	help
	  Support the dual accel and gyro function. 
	  provide sysfs for factory test.
	  request selftest to adsp_factory.
	  receive test result from adsp_factory.

config SUPPORT_DUAL_OPTIC
	tristate "Sensors support dual optic"
	default n
	help
	  Support the dual prox and light function. 
	  provide sysfs for factory test.
	  request selftest to adsp_factory.
	  receive test result from adsp_factory.

config SUPPORT_VIRTUAL_OPTIC
	tristate "Sensors support virtual optic"
	default n
	help
	  Support the virtual prox and light function. 
	  provide sysfs for factory test.
	  request selftest to adsp_factory.
	  receive test result from adsp_factory.

config SUPPORT_DEVICE_MODE
	tristate "Support device mode"
	default n
	help
	  Support device mode.
```

## drivers/battery/Kconfig
```kconfig
#
# battery driver configuration
#

comment "Battery drivers"

config BATTERY_SAMSUNG
	tristate "samsung battery driver"
	help
	 Say Y to include support for samsung battery driver
	 This battery driver integrated all battery-related functions
	 To see battery-related functions,
	 refer to sec_charging_common.h

config BATTERY_SAMSUNG_V2
	tristate "samsung battery driver version 2"
	default n
	depends on BATTERY_SAMSUNG
	help
	 Say Y to include support for samsung battery driver
	 This battery driver integrated all battery-related functions
	 To see battery-related functions,
	 refer to sec_charging_common.h

config BATTERY_SAMSUNG_V3
	tristate "samsung battery driver version 3"
	default n
	depends on BATTERY_SAMSUNG
	help
	 Say Y to include support for samsung battery driver
	 This battery driver integrated all battery-related functions
	 To see battery-related functions,
	 refer to sec_charging_common.h

#if BATTERY_SAMSUNG_V2
# source "drivers/battery/v2/Kconfig"
#endif # BATTERY_SAMSUNG_V2


if BATTERY_SAMSUNG_V3
source "drivers/battery/v3/Kconfig"
endif # BATTERY_SAMSUNG_V3
```

## drivers/sensors/Kconfig
```kconfig
config SENSORS
	bool "Sensors Class Support"
	help
	  This option enables the sensor sysfs class in /sys/class/sensors.
	  You'll need this to do anything useful with sensorss. If unsure, say N.

config SENSORS_SSC
	bool "Enable Sensors Driver Support for SSC"
	help
	  Add support for sensors SSC driver.
	  This driver is used for exercising sensors use case,
	  time syncing with ADSP clock.

config SENSORS_SX9320
	depends on I2C
	tristate "SX9320 driver"
	default n
	help
	  Say Y here if you use sx9330.
	  This option enables grip sensors using
	  SemTech sx9330 device driver.
	  Say N here if you do not use sx9330.

config SENSORS_SX9320_2CH
	depends on I2C
	tristate "SX9320 use 2ch"
	default n
	help
	  Say Y here if you use sx9320 2ch.
	  This option enables grip sensors using
	  SemTech sx9320 2ch device driver.
	  Say N here if you do not use sx9320 2ch.

config SENSORS_SX9330
	depends on I2C
	tristate "SX9330 driver"
	default n
	help
	  Say Y here if you use sx9330.
	  This option enables grip sensors using
	  SemTech sx9330 device driver.
	  Say N here if you do not use sx9330.

config SENSORS_SX9330_SUB
	depends on I2C
	tristate "SX9330 sub driver"
	default n
	help
	  Say Y here if you use sx9330 sub.
	  This option enables grip sensors using
	  SemTech sx9330 sub device driver.
	  Say N here if you do not use sx9330 sub.

config SENSORS_SX9330_SUB2
	depends on I2C
	tristate "SX9330 sub2 driver"
	default n
	help
	  Say Y here if you use sx9330 sub.
	  This option enables grip sensors using
	  SemTech sx9330 sub device driver.
	  Say N here if you do not use sx9330 sub.


config SENSORS_SX9330_WIFI
	depends on I2C
	tristate "SX9330 wifi driver"
	default n
	help
	  Say Y here if you use sx9330 wifi.
	  This option enables grip sensors using
	  SemTech sx9330 wifi device driver.
	  Say N here if you do not use sx9330 wifi.

config SENSORS_SX9330_WIFI_2CH
	depends on I2C
	tristate "SX9330 use wifi 2ch"
	default n
	help
	  Say Y here if you use sx9330 wifi 2ch.
	  This option enables grip sensors using
	  SemTech sx9330 wifi 2ch device driver.
	  Say N here if you do not use sx9330 wifi 2ch.

config SENSORS_A96T3X6
	depends on I2C
	tristate "A96T3X6 driver for grip"
	default n
	help
	  Say Y here if you use A96T3X6 for grip.
	  This option enables grip sensors using
	  Above A96T3X6 device driver for grip.
	  Say N here if you do not use A96T3X6 for grip.

config SENSORS_SYSFS
	tristate "Sensors sysfs"
	help
	  Support sysfs for sensors.
          If you say yes here you get sysfs support for
	  sensor factory test.
	  To compile this driver as a module, choose M here: the
	  module will be called sensors_core.
```
