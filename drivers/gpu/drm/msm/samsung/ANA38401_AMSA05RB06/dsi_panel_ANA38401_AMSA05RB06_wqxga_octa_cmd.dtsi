/* Copyright (c) 2013-2014, The Linux Foundation. All rights reserved.
 *
 * This program is free software; you can redistribute it and/or modify
 * it under the terms of the GNU General Public License version 2 and
 * only version 2 as published by the Free Software Foundation.
 *
 * This program is distributed in the hope that it will be useful,
 * but WITHOUT ANY WARRANTY; without even the implied warranty of
 * MERCHANTABILITY or FITNESS FOR A PARTICULAR PURPOSE.  See the
 * GNU General Public License for more details.
 */

&mdss_mdp {
	ss_dsi_panel_ANA38401_AMSA05RB06_WQXGA: ss_dsi_panel_ANA38401_AMSA05RB06_WQXGA {
		qcom,mdss-dsi-panel-name = "ss_dsi_panel_ANA38401_AMSA05RB06_WQXGA";
		label = "ss_dsi_panel_ANA38401_AMSA05RB06_WQXGA";

		qcom,mdss-dsi-panel-width = <1280>;
		qcom,mdss-dsi-panel-height = <1600>;
		qcom,mdss-dsi-bpp = <24>;

		/*qcom,mdss-dsi-force-clk-lane-hs;*/
		/*qcom,cmd-sync-wait-broadcast;*/
		/*qcom,cmd-sync-wait-trigger;*/
		/*qcom,mdss-dsi-fbc-enable=*/
		/*qcom,mdss-dsi-fbc-bpp=*/
		/*qcom,mdss-dsi-fbc-packing=*/
		/*qcom,mdss-dsi-fbc-quant-error=*/
		/*qcom,mdss-dsi-fbc-bias=*/
		/*qcom,mdss-dsi-fbc-pat-mode=*/
		/*qcom,mdss-dsi-fbc-vlc-mode=*/
		/*qcom,mdss-dsi-fbc-bflc-mode=*/
		/*qcom,mdss-dsi-fbc-h-line-budget=*/
		/*qcom,mdss-dsi-fbc-budget-ctrl=*/
		/*qcom,mdss-dsi-fbc-block-budget=*/
		/*qcom,mdss-dsi-fbc-lossless-threshold=*/
		/*qcom,mdss-dsi-fbc-lossy-threshold=*/
		/*qcom,mdss-dsi-fbc-rgb-threshold=*/
		/*qcom,mdss-dsi-fbc-lossy-mode-idx=*/

		qcom,mdss-dsi-h-back-porch = <108>;
		qcom,mdss-dsi-h-front-porch = <212>;
		qcom,mdss-dsi-h-pulse-width = <16>;
		qcom,mdss-dsi-h-sync-skew = <0>;
		qcom,mdss-dsi-v-back-porch = <6>;
		qcom,mdss-dsi-v-front-porch = <10>;
		qcom,mdss-dsi-v-pulse-width = <2>;

		qcom,mdss-dsi-h-left-border = <0>;
		qcom,mdss-dsi-h-right-border = <0>;
		qcom,mdss-dsi-v-top-border = <0>;
		qcom,mdss-dsi-v-bottom-border = <0>;

		qcom,mdss-dsi-underflow-color = <0xFF>;
		qcom,mdss-dsi-border-color = <0>;

		/*qcom,mdss-dsi-pan-enable-dynamic-fps=*/
		/*qcom,mdss-dsi-pan-fps-update=*/

		qcom,mdss-dsi-bl-pmic-control-type = "bl_ctrl_dcs";
		/*qcom,mdss-dsi-bl-pmic-bank-select=*/
		/*qcom,mdss-dsi-bl-pmic-pwm-frequency=*/
		/*qcom,mdss-dsi-pwm-gpio=*/

		qcom,mdss-dsi-bl-min-level = <1>;
		qcom,mdss-dsi-bl-max-level = <35500>;
		qcom,mdss-brightness-max-level = <35500>;
		qcom,mdss-dsi-interleave-mode = <0>;
		qcom,mdss-dsi-panel-type = "dsi_cmd_mode";
		qcom,mdss-dsi-force-clock-lane-hs;

		qcom,mdss-dsi-te-check-enable;
		qcom,mdss-dsi-te-using-te-pin;
		qcom,mdss-dsi-te-pin-select = <1>;

		qcom,mdss-dsi-te-dcs-command = <1>;
		qcom,mdss-dsi-wr-mem-start = <0x2C>;
		qcom,mdss-dsi-wr-mem-continue = <0x3C>;

		/* CMD mode panel doesn't need below stuff */
		/*qcom,mdss-dsi-h-sync-pulse=*/
		/*qcom,mdss-dsi-hfp-power-mode=*/
		/*qcom,mdss-dsi-hbp-power-mode=*/
		/*qcom,mdss-dsi-hsa-power-mode=*/
		/*qcom,mdss-dsi-last-line-interleave=*/
		/*qcom,mdss-dsi-bllp-eof-power-mode;*/
		/*qcom,mdss-dsi-bllp-power-mode;*/
		/*qcom,mdss-dsi-traffic-mode= "burst_mode";*/

		qcom,mdss-dsi-pixel-packing = "loose";

		qcom,mdss-dsi-virtual-channel-id = <0>;
		qcom,mdss-dsi-color-order = "rgb_swap_rgb";
		qcom,mdss-dsi-lane-0-state;
		qcom,mdss-dsi-lane-1-state;
		qcom,mdss-dsi-lane-2-state;
		qcom,mdss-dsi-lane-3-state;
		qcom,mdss-dsi-lane-map = "lane_map_0123";
		qcom,mdss-dsi-t-clk-pre = <0x2F>;
		qcom,mdss-dsi-t-clk-post = <0x0D>;

		qcom,mdss-dsi-stream = <0>;
		qcom,mdss-dsi-mdp-trigger = "none";
		qcom,mdss-dsi-dma-trigger = "trigger_sw";
		qcom,mdss-dsi-panel-framerate = <60>;
		qcom,mdss-dsi-panel-clockrate = <898000000>;
		qcom,mdss-dsi-on-command-state = "dsi_hs_mode";
		qcom,mdss-dsi-off-command-state = "dsi_hs_mode";

		qcom,mdss-pan-physical-width-dimension = <227>;
		qcom,mdss-pan-physical-height-dimension = <142>;

		qcom,mdss-dsi-panel-mode-gpio-state = "invalid";
		qcom,mdss-dsi-reset-sequence = <0 70>, <1 0>;

		/*qcom,partial-update-enabled;*/
		/*qcom,partial-update-roi-merge;*/
		/*qcom,panel-roi-alignment=<8 8 1 1 1 1>;*/
		/*qcom,mdss-dsi-horizontal-line-idle*/

		/*qcom,mdss-dsi-lp11-init;*/
		qcom,mdss-dsi-init-delay-us = <1000>;

		qcom,mdss-dsi-rx-eot-ignore;
		qcom,mdss-dsi-tx-eot-append;

		/*qcom,ulps-enabled*/
		/*qcom,suspend-ulps-enabled;*/
		/*qcom,mdss-dsi-panel-status-command=*/
		/*qcom,mdss-dsi-panel-status-command-mode="dsi_lp_mode";*/

		qcom,esd-check-enabled;
		qcom,mdss-dsi-panel-status-check-mode="irq_check";
		qcom,mdss-dsi-panel-status-irq-trigger1="falling";

		qcom,mdss-dsi-panel-hdr-enabled;
		qcom,mdss-dsi-panel-hdr-color-primaries = <14880 15935 32435
			16555 14945 30910 7790 3415>;
		qcom,mdss-dsi-panel-peak-brightness = <5643000>;
		qcom,mdss-dsi-panel-average-brightness = <2000000>;
		qcom,mdss-dsi-panel-blackness-level = <6134>;

		/*qcom,mdss-dsi-panel-status-value = <1>;*/
		/*qcom,mdss-dsi-panel-orientation = "180";*/
		/*qcom,dynamic-mode-switch-enabled*/
		/*qcom,video-to-cmd-mode-switch-commands=*/
		/*qcom,cmd-to-video-mode-switch-commands=*/
/*
 * ************************************************************************************************************************************
 *
 *
 *			Below  parameters are samsung dependent thigs
 *
 *
 * ************************************************************************************************************************************
 */
		samsung,panel-vendor = "SDC";
		samsung,disp-model = "AMSA05RB06";
		samsung,support_panel_max = <1>;
		samsung,tcon-clk-on-support;
		samsung,cmds-unicast; /* if display->ctrl_count is 2, it broadcasts. To prevent to send mipi cmd thru mipi dsi1, set unicast flag */
		samsung,anapass-power-seq;
		samsung,support_gpara;
		samsung,support_pac;
		samsung,wait_after_sleep_out_delay = <220>;
		samsung,support_mdnie_lite;
		samsung,elvss_interpolation_temperature = <(-20)>;

		/*samsung ESD pin*/
		//samsung,esd-irq-gpio1 = <&tlmm 5 0>;
		//samsung,dsi_force_clock_lane_hs;

		/*samsung,panel-lpm-enable;*/
		/*samsung,support_irc;*/

		/*samsung,support_factory_panel_swap;*/

		/*samsung,line_split;*/

		/*
		the last byte in read commands	represent READ LENGH,
		like below  READ LENGH = 0x21
		*/

		/*
		* ************************************************************************************************************************
		*  Tx
		* ************************************************************************************************************************
		*/

		/* BRIGHTNESS_MAX_PACKET = 50 */
		samsung,brightness_tx_cmds_revA = [
			39 01 00 00 00 00 22 83	80 80 80 80 80 80 80 00	80 80 00 80 80 80 80 80 80 80 00 80 80 00 80 80 80 80 80 80 80 00 80 80 00
			39 01 00 00 00 00 22 83	80 80 80 80 80 80 80 00	80 80 00 80 80 80 80 80 80 80 00 80 80 00 80 80 80 80 80 80 80 00 80 80 00
			39 01 00 00 00 00 22 83	80 80 80 80 80 80 80 00	80 80 00 80 80 80 80 80 80 80 00 80 80 00 80 80 80 80 80 80 80 00 80 80 00
			39 01 00 00 00 00 22 83	80 80 80 80 80 80 80 00	80 80 00 80 80 80 80 80 80 80 00 80 80 00 80 80 80 80 80 80 80 00 80 80 00
			39 01 00 00 00 00 22 83	80 80 80 80 80 80 80 00	80 80 00 80 80 80 80 80 80 80 00 80 80 00 80 80 80 80 80 80 80 00 80 80 00
			39 01 00 00 00 00 22 83	80 80 80 80 80 80 80 00	80 80 00 80 80 80 80 80 80 80 00 80 80 00 80 80 80 80 80 80 80 00 80 80 00
			39 01 00 00 00 00 22 83	80 80 80 80 80 80 80 00	80 80 00 80 80 80 80 80 80 80 00 80 80 00 80 80 80 80 80 80 80 00 80 80 00
			39 01 00 00 00 00 22 83	80 80 80 80 80 80 80 00	80 80 00 80 80 80 80 80 80 80 00 80 80 00 80 80 80 80 80 80 80 00 80 80 00
			39 01 00 00 00 00 22 83	80 80 80 80 80 80 80 00	80 80 00 80 80 80 80 80 80 80 00 80 80 00 80 80 80 80 80 80 80 00 80 80 00
			39 01 00 00 00 00 22 83	80 80 80 80 80 80 80 00	80 80 00 80 80 80 80 80 80 80 00 80 80 00 80 80 80 80 80 80 80 00 80 80 00
			39 01 00 00 00 00 22 83	80 80 80 80 80 80 80 00	80 80 00 80 80 80 80 80 80 80 00 80 80 00 80 80 80 80 80 80 80 00 80 80 00
			39 01 00 00 00 00 22 83	80 80 80 80 80 80 80 00	80 80 00 80 80 80 80 80 80 80 00 80 80 00 80 80 80 80 80 80 80 00 80 80 00
			39 01 00 00 00 00 22 83	80 80 80 80 80 80 80 00	80 80 00 80 80 80 80 80 80 80 00 80 80 00 80 80 80 80 80 80 80 00 80 80 00
			39 01 00 00 00 00 22 83	80 80 80 80 80 80 80 00	80 80 00 80 80 80 80 80 80 80 00 80 80 00 80 80 80 80 80 80 80 00 80 80 00
			39 01 00 00 00 00 22 83	80 80 80 80 80 80 80 00	80 80 00 80 80 80 80 80 80 80 00 80 80 00 80 80 80 80 80 80 80 00 80 80 00
			39 01 00 00 00 00 22 83	80 80 80 80 80 80 80 00	80 80 00 80 80 80 80 80 80 80 00 80 80 00 80 80 80 80 80 80 80 00 80 80 00
			39 01 00 00 00 00 22 83	80 80 80 80 80 80 80 00	80 80 00 80 80 80 80 80 80 80 00 80 80 00 80 80 80 80 80 80 80 00 80 80 00
			39 01 00 00 00 00 22 83	80 80 80 80 80 80 80 00	80 80 00 80 80 80 80 80 80 80 00 80 80 00 80 80 80 80 80 80 80 00 80 80 00
			39 01 00 00 00 00 22 83	80 80 80 80 80 80 80 00	80 80 00 80 80 80 80 80 80 80 00 80 80 00 80 80 80 80 80 80 80 00 80 80 00
			39 01 00 00 00 00 22 83	80 80 80 80 80 80 80 00	80 80 00 80 80 80 80 80 80 80 00 80 80 00 80 80 80 80 80 80 80 00 80 80 00
			39 01 00 00 00 00 22 83	80 80 80 80 80 80 80 00	80 80 00 80 80 80 80 80 80 80 00 80 80 00 80 80 80 80 80 80 80 00 80 80 00
			39 01 00 00 00 00 22 83	80 80 80 80 80 80 80 00	80 80 00 80 80 80 80 80 80 80 00 80 80 00 80 80 80 80 80 80 80 00 80 80 00
			39 01 00 00 00 00 22 83	80 80 80 80 80 80 80 00	80 80 00 80 80 80 80 80 80 80 00 80 80 00 80 80 80 80 80 80 80 00 80 80 00
			39 01 00 00 00 00 22 83	80 80 80 80 80 80 80 00	80 80 00 80 80 80 80 80 80 80 00 80 80 00 80 80 80 80 80 80 80 00 80 80 00
			39 01 00 00 00 00 22 83	80 80 80 80 80 80 80 00	80 80 00 80 80 80 80 80 80 80 00 80 80 00 80 80 80 80 80 80 80 00 80 80 00
			39 01 00 00 00 00 22 83	80 80 80 80 80 80 80 00	80 80 00 80 80 80 80 80 80 80 00 80 80 00 80 80 80 80 80 80 80 00 80 80 00
			39 01 00 00 00 00 22 83	80 80 80 80 80 80 80 00	80 80 00 80 80 80 80 80 80 80 00 80 80 00 80 80 80 80 80 80 80 00 80 80 00
			39 01 00 00 00 00 22 83	80 80 80 80 80 80 80 00	80 80 00 80 80 80 80 80 80 80 00 80 80 00 80 80 80 80 80 80 80 00 80 80 00
			39 01 00 00 00 00 22 83	80 80 80 80 80 80 80 00	80 80 00 80 80 80 80 80 80 80 00 80 80 00 80 80 80 80 80 80 80 00 80 80 00
			39 01 00 00 00 00 22 83	80 80 80 80 80 80 80 00	80 80 00 80 80 80 80 80 80 80 00 80 80 00 80 80 80 80 80 80 80 00 80 80 00
			39 01 00 00 00 00 22 83	80 80 80 80 80 80 80 00	80 80 00 80 80 80 80 80 80 80 00 80 80 00 80 80 80 80 80 80 80 00 80 80 00
			39 01 00 00 00 00 22 83	80 80 80 80 80 80 80 00	80 80 00 80 80 80 80 80 80 80 00 80 80 00 80 80 80 80 80 80 80 00 80 80 00
			39 01 00 00 00 00 22 83	80 80 80 80 80 80 80 00	80 80 00 80 80 80 80 80 80 80 00 80 80 00 80 80 80 80 80 80 80 00 80 80 00
			39 01 00 00 00 00 22 83	80 80 80 80 80 80 80 00	80 80 00 80 80 80 80 80 80 80 00 80 80 00 80 80 80 80 80 80 80 00 80 80 00
			39 01 00 00 00 00 22 83	80 80 80 80 80 80 80 00	80 80 00 80 80 80 80 80 80 80 00 80 80 00 80 80 80 80 80 80 80 00 80 80 00
			39 01 00 00 00 00 22 83	80 80 80 80 80 80 80 00	80 80 00 80 80 80 80 80 80 80 00 80 80 00 80 80 80 80 80 80 80 00 80 80 00
			39 01 00 00 00 00 22 83	80 80 80 80 80 80 80 00	80 80 00 80 80 80 80 80 80 80 00 80 80 00 80 80 80 80 80 80 80 00 80 80 00
			39 01 00 00 00 00 22 83	80 80 80 80 80 80 80 00	80 80 00 80 80 80 80 80 80 80 00 80 80 00 80 80 80 80 80 80 80 00 80 80 00
			39 01 00 00 00 00 22 83	80 80 80 80 80 80 80 00	80 80 00 80 80 80 80 80 80 80 00 80 80 00 80 80 80 80 80 80 80 00 80 80 00
			39 01 00 00 00 00 22 83	80 80 80 80 80 80 80 00	80 80 00 80 80 80 80 80 80 80 00 80 80 00 80 80 80 80 80 80 80 00 80 80 00
			39 01 00 00 00 00 22 83	80 80 80 80 80 80 80 00	80 80 00 80 80 80 80 80 80 80 00 80 80 00 80 80 80 80 80 80 80 00 80 80 00
			39 01 00 00 00 00 22 83	80 80 80 80 80 80 80 00	80 80 00 80 80 80 80 80 80 80 00 80 80 00 80 80 80 80 80 80 80 00 80 80 00
			39 01 00 00 00 00 22 83	80 80 80 80 80 80 80 00	80 80 00 80 80 80 80 80 80 80 00 80 80 00 80 80 80 80 80 80 80 00 80 80 00
			39 01 00 00 00 00 22 83	80 80 80 80 80 80 80 00	80 80 00 80 80 80 80 80 80 80 00 80 80 00 80 80 80 80 80 80 80 00 80 80 00
			39 01 00 00 00 00 22 83	80 80 80 80 80 80 80 00	80 80 00 80 80 80 80 80 80 80 00 80 80 00 80 80 80 80 80 80 80 00 80 80 00
			39 01 00 00 00 00 22 83	80 80 80 80 80 80 80 00	80 80 00 80 80 80 80 80 80 80 00 80 80 00 80 80 80 80 80 80 80 00 80 80 00
			39 01 00 00 00 00 22 83	80 80 80 80 80 80 80 00	80 80 00 80 80 80 80 80 80 80 00 80 80 00 80 80 80 80 80 80 80 00 80 80 00
			39 01 00 00 00 00 22 83	80 80 80 80 80 80 80 00	80 80 00 80 80 80 80 80 80 80 00 80 80 00 80 80 80 80 80 80 80 00 80 80 00
			39 01 00 00 00 00 22 83	80 80 80 80 80 80 80 00	80 80 00 80 80 80 80 80 80 80 00 80 80 00 80 80 80 80 80 80 80 00 80 80 00
		];

		samsung,packet_size_tx_cmds_revA = [
			37 01 00 00 00 00 02 21 00
		];

		/*
		 * First parameters can be changed
		 * by function of samsung_nv_read()
		 * because of that means offset of
		 * read position
		 */
		samsung,reg_read_pos_tx_cmds_revA = [
			15 01 00 00 00 00 02 B0 00
		];

		samsung,smart_dimming_mtp_rx_cmds_revA	= [24 01 00 00 00 00 02 D8 FF 21 5A];	/* 0xFF is "address + read_size", 0x21 real read size, Offset 0x5A */
		samsung,mdnie_read_rx_cmds_revA 	= [24 01 00 00 00 00 02 D8 FF 04 7B];	/* 0xFF is "address + read_size", 0x04 real read size, Offset 0x7B */
		samsung,elvss_rx_cmds_revA		= [24 01 00 00 00 00 02 D2 FF 01 70];	/* 0xFF is "address + read_size", 0x01 real read size, Offset 0x70 */
		samsung,mtp_read_sysfs_rx_cmds_revA     = [24 01 00 00 00 00 02 00 00 00 00];

		samsung,manufacture_id0_rx_cmds_revA 	= [06 01 00 00 00 00 01 DA 01 00];
		samsung,manufacture_id1_rx_cmds_revA 	= [06 01 00 00 00 00 01 DB 01 00];
		samsung,manufacture_id2_rx_cmds_revA 	= [06 01 00 00 00 00 01 DC 01 00];

		samsung,manufacture_date_rx_cmds_revA 	= [24 01 00 00 00 00 02 D8 FF 07 86]; /* 0xFF is "address + read_size", 0x07 real read size, Offset 0x86 */
		samsung,cell_id_rx_cmds_revA 		= [24 01 00 00 00 00 02 D8 FF 07 86];	/* 0xFF is "address + read_size", 0x07 real read size, Offset 0x86 */


		samsung,display_on_tx_cmds_revA = [05 01 00 00 00 00 02 29 00];
		samsung,display_off_tx_cmds_revA = [05 01 00 00 64 00 02 28 00];

		/*
		* ************************************************************************************************************************
		*  GAMMA
		* ************************************************************************************************************************
		*/
		samsung,gamma_tx_cmds_revA = [
			39 01 00 00 00 00 22			/* Brightness condition set */
			83 80 80 80 80 80 80
			80 00 80 80 00 80 80
			80 80 80 80 80 00 80
			80 00 80 80 80 80 80
			80 80 00 80 80 00

			15 01 00 00 00 00 02 B0 35		/* Global Para 53rd */
			39 01 00 00 00 00 02 B2 01		/* Update key */
		];

		/*
		* ************************************************************************************************************************
		*  HBM
		* ************************************************************************************************************************
		*/
		samsung,hbm_rx_cmds_revA  = [24 01 00 00 00 00 02 D4 FF 21 5B]; /* 0xFF is "address + read_size", 0x20 real read size, Offset 91(0x5B) Para  : HBM GAMMA */
		samsung,hbm2_rx_cmds_revA = [24 01 00 00 00 00 02 D8 FF 01 81]; /* 0xFF is "address + read_size", 0x01 real read size, Offset 129(0x81) Para : HBM ELVSS */

		samsung,hbm_gamma_tx_cmds_revA = [
			39 01 00 00 00 00 22			/* Brightness condition set */
			83 80 80 80 80 80 80
			80 00 80 80 00 80 80
			80 80 80 80 80 00 80
			80 00 80 80 80 80 80
			80 80 00 80 80 00
		];

		samsung,hbm_etc_tx_cmds_revA = [
			39 01 00 00 00 00 04 90 00 00 0E	/* AID 360 nit */
			15 01 00 00 00 00 02 B0 70		/* Global Para 112nd */
			39 01 00 00 00 00 02 B2 00		/* HBM ELVSS : 0xD8h 129th data */
			15 01 00 00 00 00 02 B0 67		/* Global Para 103rd */
			39 01 00 00 00 00 02 B2 0F		/* ELVSS dim offset : Table2 */
			15 01 00 00 00 00 02 B0 4D		/* Global Para 77th */
			39 01 00 00 00 00 02 B2 05		/* 32 Frame Avg at ACL on */
			15 01 00 00 00 00 02 B0 49		/* Global Para 73th */
			39 01 00 00 00 00 02 B2 99		/* Start setting: 60% start */
			15 01 00 00 00 00 02 B0 36		/* Global Para 54th */
			39 01 00 00 00 00 02 B2 11		/* ACL 8% on */
			15 01 00 00 00 00 02 B0 35		/* Global Para 53rd */
			39 01 00 00 00 00 02 B2 01		/* Update key */
		];

		samsung,hbm_off_tx_cmds_revA = [
			15 00 00 00 00 00 02 B0 70		/* Global Para 112nd */
			39 00 00 00 00 00 02 B2 00		/* HBM ELVSS */
		];

		/*
		* ************************************************************************************************************************
		* AID command list and mappings
		* ************************************************************************************************************************
		*/

		samsung,pac_aid_subdivision_tx_cmds_revA = [
						/* AOR   bl   */
			39 01 00 00 00 00 04 90 01 00 8D /*   0 */
			39 01 00 00 00 00 04 90 01 00 8A /*   1 */
			39 01 00 00 00 00 04 90 01 00 87 /*   2 */
			39 01 00 00 00 00 04 90 01 00 84 /*   3 */
			39 01 00 00 00 00 04 90 01 00 80 /*   4 */
			39 01 00 00 00 00 04 90 01 00 7E /*   5 */
			39 01 00 00 00 00 04 90 01 00 7A /*   6 */
			39 01 00 00 00 00 04 90 01 00 77 /*   7 */
			39 01 00 00 00 00 04 90 01 00 74 /*   8 */
			39 01 00 00 00 00 04 90 01 00 6F /*   9 */
			39 01 00 00 00 00 04 90 01 00 6D /*  10 */
			39 01 00 00 00 00 04 90 01 00 6A /*  11 */
			39 01 00 00 00 00 04 90 01 00 66 /*  12 */
			39 01 00 00 00 00 04 90 01 00 63 /*  13 */
			39 01 00 00 00 00 04 90 01 00 5F /*  14 */
			39 01 00 00 00 00 04 90 01 00 5C /*  15 */
			39 01 00 00 00 00 04 90 01 00 55 /*  16 */
			39 01 00 00 00 00 04 90 01 00 52 /*  17 */
			39 01 00 00 00 00 04 90 01 00 4E /*  18 */
			39 01 00 00 00 00 04 90 01 00 4A /*  19 */
			39 01 00 00 00 00 04 90 01 00 44 /*  20 */
			39 01 00 00 00 00 04 90 01 00 40 /*  21 */
			39 01 00 00 00 00 04 90 01 00 3D /*  22 */
			39 01 00 00 00 00 04 90 01 00 3A /*  23 */
			39 01 00 00 00 00 04 90 01 00 36 /*  24 */
			39 01 00 00 00 00 04 90 01 00 32 /*  25 */
			39 01 00 00 00 00 04 90 01 00 30 /*  26 */
			39 01 00 00 00 00 04 90 01 00 2F /*  27 */
			39 01 00 00 00 00 04 90 01 00 2C /*  28 */
			39 01 00 00 00 00 04 90 01 00 28 /*  29 */
			39 01 00 00 00 00 04 90 01 00 24 /*  30 */
			39 01 00 00 00 00 04 90 01 00 20 /*  31 */
			39 01 00 00 00 00 04 90 01 00 1B /*  32 */
			39 01 00 00 00 00 04 90 01 00 16 /*  33 */
			39 01 00 00 00 00 04 90 01 00 12 /*  34 */
			39 01 00 00 00 00 04 90 01 00 0E /*  35 */
			39 01 00 00 00 00 04 90 01 00 0B /*  36 */
			39 01 00 00 00 00 04 90 01 00 07 /*  37 */
			39 01 00 00 00 00 04 90 01 00 02 /*  38 */
			39 01 00 00 00 00 04 90 00 00 FC /*  39 */
			39 01 00 00 00 00 04 90 00 00 F7 /*  40 */
			39 01 00 00 00 00 04 90 00 00 F2 /*  41 */
			39 01 00 00 00 00 04 90 00 00 EC /*  42 */
			39 01 00 00 00 00 04 90 00 00 E6 /*  43 */
			39 01 00 00 00 00 04 90 00 00 E1 /*  44 */
			39 01 00 00 00 00 04 90 00 00 DB /*  45 */
			39 01 00 00 00 00 04 90 00 00 D7 /*  46 */
			39 01 00 00 00 00 04 90 00 00 D3 /*  47 */
			39 01 00 00 00 00 04 90 00 00 CF /*  48 */
			39 01 00 00 00 00 04 90 00 00 CA /*  49 */
			39 01 00 00 00 00 04 90 00 00 C4 /*  50 */
			39 01 00 00 00 00 04 90 00 00 BF /*  51 */
			39 01 00 00 00 00 04 90 00 00 BA /*  52 */
			39 01 00 00 00 00 04 90 00 00 B6 /*  53 */
			39 01 00 00 00 00 04 90 00 00 B1 /*  54 */
			39 01 00 00 00 00 04 90 00 00 AC /*  55 */
			39 01 00 00 00 00 04 90 00 00 A8 /*  56 */
			39 01 00 00 00 00 04 90 00 00 A3 /*  57 */
			39 01 00 00 00 00 04 90 00 00 A5 /*  58 */
			39 01 00 00 00 00 04 90 00 00 A1 /*  59 */
			39 01 00 00 00 00 04 90 00 00 9C /*  60 */
			39 01 00 00 00 00 04 90 00 00 A7 /*  61 */
			39 01 00 00 00 00 04 90 00 00 A1 /*  62 */
			39 01 00 00 00 00 04 90 00 00 9C /*  63 */
			39 01 00 00 00 00 04 90 00 00 A6 /*  64 */
			39 01 00 00 00 00 04 90 00 00 A1 /*  65 */
			39 01 00 00 00 00 04 90 00 00 9C /*  66 */
			39 01 00 00 00 00 04 90 00 00 A5 /*  67 */
			39 01 00 00 00 00 04 90 00 00 A1 /*  68 */
			39 01 00 00 00 00 04 90 00 00 9C /*  69 */
			39 01 00 00 00 00 04 90 00 00 A7 /*  70 */
			39 01 00 00 00 00 04 90 00 00 A1 /*  71 */
			39 01 00 00 00 00 04 90 00 00 9C /*  72 */
			39 01 00 00 00 00 04 90 00 00 A5 /*  73 */
			39 01 00 00 00 00 04 90 00 00 A2 /*  74 */
			39 01 00 00 00 00 04 90 00 00 9F /*  75 */
			39 01 00 00 00 00 04 90 00 00 9C /*  76 */
			39 01 00 00 00 00 04 90 00 00 A8 /*  77 */
			39 01 00 00 00 00 04 90 00 00 A4 /*  78 */
			39 01 00 00 00 00 04 90 00 00 A0 /*  79 */
			39 01 00 00 00 00 04 90 00 00 9C /*  80 */
			39 01 00 00 00 00 04 90 00 00 A7 /*  81 */
			39 01 00 00 00 00 04 90 00 00 A5 /*  82 */
			39 01 00 00 00 00 04 90 00 00 A3 /*  83 */
			39 01 00 00 00 00 04 90 00 00 A0 /*  84 */
			39 01 00 00 00 00 04 90 00 00 9E /*  85 */
			39 01 00 00 00 00 04 90 00 00 9C /*  86 */
			39 01 00 00 00 00 04 90 00 00 A9 /*  87 */
			39 01 00 00 00 00 04 90 00 00 A6 /*  88 */
			39 01 00 00 00 00 04 90 00 00 A3 /*  89 */
			39 01 00 00 00 00 04 90 00 00 9F /*  90 */
			39 01 00 00 00 00 04 90 00 00 9C /*  91 */
			39 01 00 00 00 00 04 90 00 00 A7 /*  92 */
			39 01 00 00 00 00 04 90 00 00 A5 /*  93 */
			39 01 00 00 00 00 04 90 00 00 A3 /*  94 */
			39 01 00 00 00 00 04 90 00 00 A1 /*  95 */
			39 01 00 00 00 00 04 90 00 00 9E /*  96 */
			39 01 00 00 00 00 04 90 00 00 9C /*  97 */
			39 01 00 00 00 00 04 90 00 00 A9 /*  98 */
			39 01 00 00 00 00 04 90 00 00 A7 /*  99 */
			39 01 00 00 00 00 04 90 00 00 A4 /* 100 */
			39 01 00 00 00 00 04 90 00 00 A2 /* 101 */
			39 01 00 00 00 00 04 90 00 00 A0 /* 102 */
			39 01 00 00 00 00 04 90 00 00 9E /* 103 */
			39 01 00 00 00 00 04 90 00 00 9C /* 104 */
			39 01 00 00 00 00 04 90 00 00 A9 /* 105 */
			39 01 00 00 00 00 04 90 00 00 A6 /* 106 */
			39 01 00 00 00 00 04 90 00 00 A4 /* 107 */
			39 01 00 00 00 00 04 90 00 00 A1 /* 108 */
			39 01 00 00 00 00 04 90 00 00 9F /* 109 */
			39 01 00 00 00 00 04 90 00 00 9C /* 110 */
			39 01 00 00 00 00 04 90 00 00 A9 /* 111 */
			39 01 00 00 00 00 04 90 00 00 A7 /* 112 */
			39 01 00 00 00 00 04 90 00 00 A5 /* 113 */
			39 01 00 00 00 00 04 90 00 00 A3 /* 114 */
			39 01 00 00 00 00 04 90 00 00 A1 /* 115 */
			39 01 00 00 00 00 04 90 00 00 A0 /* 116 */
			39 01 00 00 00 00 04 90 00 00 9E /* 117 */
			39 01 00 00 00 00 04 90 00 00 9C /* 118 */
			39 01 00 00 00 00 04 90 00 00 A9 /* 119 */
			39 01 00 00 00 00 04 90 00 00 A7 /* 120 */
			39 01 00 00 00 00 04 90 00 00 A5 /* 121 */
			39 01 00 00 00 00 04 90 00 00 A3 /* 122 */
			39 01 00 00 00 00 04 90 00 00 A0 /* 123 */
			39 01 00 00 00 00 04 90 00 00 9E /* 124 */
			39 01 00 00 00 00 04 90 00 00 9C /* 125 */
			39 01 00 00 00 00 04 90 00 00 9B /* 126 */
			39 01 00 00 00 00 04 90 00 00 99 /* 127 */
			39 01 00 00 00 00 04 90 00 00 98 /* 128 */
			39 01 00 00 00 00 04 90 00 00 96 /* 129 */
			39 01 00 00 00 00 04 90 00 00 94 /* 130 */
			39 01 00 00 00 00 04 90 00 00 92 /* 131 */
			39 01 00 00 00 00 04 90 00 00 90 /* 132 */
			39 01 00 00 00 00 04 90 00 00 8E /* 133 */
			39 01 00 00 00 00 04 90 00 00 8C /* 134 */
			39 01 00 00 00 00 04 90 00 00 8A /* 135 */
			39 01 00 00 00 00 04 90 00 00 88 /* 136 */
			39 01 00 00 00 00 04 90 00 00 86 /* 137 */
			39 01 00 00 00 00 04 90 00 00 84 /* 138 */
			39 01 00 00 00 00 04 90 00 00 82 /* 139 */
			39 01 00 00 00 00 04 90 00 00 80 /* 140 */
			39 01 00 00 00 00 04 90 00 00 7E /* 141 */
			39 01 00 00 00 00 04 90 00 00 7C /* 142 */
			39 01 00 00 00 00 04 90 00 00 79 /* 143 */
			39 01 00 00 00 00 04 90 00 00 77 /* 144 */
			39 01 00 00 00 00 04 90 00 00 74 /* 145 */
			39 01 00 00 00 00 04 90 00 00 72 /* 146 */
			39 01 00 00 00 00 04 90 00 00 70 /* 147 */
			39 01 00 00 00 00 04 90 00 00 6D /* 148 */
			39 01 00 00 00 00 04 90 00 00 6A /* 149 */
			39 01 00 00 00 00 04 90 00 00 68 /* 150 */
			39 01 00 00 00 00 04 90 00 00 66 /* 151 */
			39 01 00 00 00 00 04 90 00 00 64 /* 152 */
			39 01 00 00 00 00 04 90 00 00 62 /* 153 */
			39 01 00 00 00 00 04 90 00 00 60 /* 154 */
			39 01 00 00 00 00 04 90 00 00 5E /* 155 */
			39 01 00 00 00 00 04 90 00 00 5C /* 156 */
			39 01 00 00 00 00 04 90 00 00 5A /* 157 */
			39 01 00 00 00 00 04 90 00 00 58 /* 158 */
			39 01 00 00 00 00 04 90 00 00 56 /* 159 */
			39 01 00 00 00 00 04 90 00 00 54 /* 160 */
			39 01 00 00 00 00 04 90 00 00 52 /* 161 */
			39 01 00 00 00 00 04 90 00 00 50 /* 162 */
			39 01 00 00 00 00 04 90 00 00 4D /* 163 */
			39 01 00 00 00 00 04 90 00 00 4B /* 164 */
			39 01 00 00 00 00 04 90 00 00 49 /* 165 */
			39 01 00 00 00 00 04 90 00 00 47 /* 166 */
			39 01 00 00 00 00 04 90 00 00 45 /* 167 */
			39 01 00 00 00 00 04 90 00 00 42 /* 168 */
			39 01 00 00 00 00 04 90 00 00 40 /* 169 */
			39 01 00 00 00 00 04 90 00 00 3E /* 170 */
			39 01 00 00 00 00 04 90 00 00 3C /* 171 */
			39 01 00 00 00 00 04 90 00 00 39 /* 172 */
			39 01 00 00 00 00 04 90 00 00 37 /* 173 */
			39 01 00 00 00 00 04 90 00 00 35 /* 174 */
			39 01 00 00 00 00 04 90 00 00 32 /* 175 */
			39 01 00 00 00 00 04 90 00 00 30 /* 176 */
			39 01 00 00 00 00 04 90 00 00 2D /* 177 */
			39 01 00 00 00 00 04 90 00 00 2B /* 178 */
			39 01 00 00 00 00 04 90 00 00 29 /* 179 */
			39 01 00 00 00 00 04 90 00 00 26 /* 180 */
			39 01 00 00 00 00 04 90 00 00 24 /* 181 */
			39 01 00 00 00 00 04 90 00 00 22 /* 182 */
			39 01 00 00 00 00 04 90 00 00 20 /* 183 */
			39 01 00 00 00 00 04 90 00 00 1E /* 184 */
			39 01 00 00 00 00 04 90 00 00 1C /* 185 */
			39 01 00 00 00 00 04 90 00 00 1A /* 186 */
			39 01 00 00 00 00 04 90 00 00 18 /* 187 */
			39 01 00 00 00 00 04 90 00 00 16 /* 188 */
			39 01 00 00 00 00 04 90 00 00 14 /* 189 */
			39 01 00 00 00 00 04 90 00 00 12 /* 190 */
			39 01 00 00 00 00 04 90 00 00 10 /* 191 */
			39 01 00 00 00 00 04 90 00 00 0E /* 192 */
			39 01 00 00 00 00 04 90 00 00 23 /* 193 */
			39 01 00 00 00 00 04 90 00 00 21 /* 194 */
			39 01 00 00 00 00 04 90 00 00 1F /* 195 */
			39 01 00 00 00 00 04 90 00 00 1D /* 196 */
			39 01 00 00 00 00 04 90 00 00 1B /* 197 */
			39 01 00 00 00 00 04 90 00 00 19 /* 198 */
			39 01 00 00 00 00 04 90 00 00 17 /* 199 */
			39 01 00 00 00 00 04 90 00 00 14 /* 200 */
			39 01 00 00 00 00 04 90 00 00 12 /* 201 */
			39 01 00 00 00 00 04 90 00 00 10 /* 202 */
			39 01 00 00 00 00 04 90 00 00 0E /* 203 */
			39 01 00 00 00 00 04 90 00 00 23 /* 204 */
			39 01 00 00 00 00 04 90 00 00 21 /* 205 */
			39 01 00 00 00 00 04 90 00 00 1F /* 206 */
			39 01 00 00 00 00 04 90 00 00 1D /* 207 */
			39 01 00 00 00 00 04 90 00 00 1B /* 208 */
			39 01 00 00 00 00 04 90 00 00 19 /* 209 */
			39 01 00 00 00 00 04 90 00 00 17 /* 210 */
			39 01 00 00 00 00 04 90 00 00 14 /* 211 */
			39 01 00 00 00 00 04 90 00 00 12 /* 212 */
			39 01 00 00 00 00 04 90 00 00 10 /* 213 */
			39 01 00 00 00 00 04 90 00 00 0E /* 214 */
			39 01 00 00 00 00 04 90 00 00 23 /* 215 */
			39 01 00 00 00 00 04 90 00 00 21 /* 216 */
			39 01 00 00 00 00 04 90 00 00 1F /* 217 */
			39 01 00 00 00 00 04 90 00 00 1D /* 218 */
			39 01 00 00 00 00 04 90 00 00 1B /* 219 */
			39 01 00 00 00 00 04 90 00 00 19 /* 220 */
			39 01 00 00 00 00 04 90 00 00 17 /* 221 */
			39 01 00 00 00 00 04 90 00 00 14 /* 222 */
			39 01 00 00 00 00 04 90 00 00 12 /* 223 */
			39 01 00 00 00 00 04 90 00 00 10 /* 224 */
			39 01 00 00 00 00 04 90 00 00 0E /* 225 */
			39 01 00 00 00 00 04 90 00 00 20 /* 226 */
			39 01 00 00 00 00 04 90 00 00 1E /* 227 */
			39 01 00 00 00 00 04 90 00 00 1C /* 228 */
			39 01 00 00 00 00 04 90 00 00 1A /* 229 */
			39 01 00 00 00 00 04 90 00 00 18 /* 230 */
			39 01 00 00 00 00 04 90 00 00 16 /* 231 */
			39 01 00 00 00 00 04 90 00 00 14 /* 232 */
			39 01 00 00 00 00 04 90 00 00 12 /* 233 */
			39 01 00 00 00 00 04 90 00 00 10 /* 234 */
			39 01 00 00 00 00 04 90 00 00 0E /* 235 */
			39 01 00 00 00 00 04 90 00 00 20 /* 236 */
			39 01 00 00 00 00 04 90 00 00 1E /* 237 */
			39 01 00 00 00 00 04 90 00 00 1C /* 238 */
			39 01 00 00 00 00 04 90 00 00 1A /* 239 */
			39 01 00 00 00 00 04 90 00 00 18 /* 240 */
			39 01 00 00 00 00 04 90 00 00 16 /* 241 */
			39 01 00 00 00 00 04 90 00 00 14 /* 242 */
			39 01 00 00 00 00 04 90 00 00 12 /* 243 */
			39 01 00 00 00 00 04 90 00 00 10 /* 244 */
			39 01 00 00 00 00 04 90 00 00 0E /* 245 */
			39 01 00 00 00 00 04 90 00 00 28 /* 246 */
			39 01 00 00 00 00 04 90 00 00 25 /* 247 */
			39 01 00 00 00 00 04 90 00 00 22 /* 248 */
			39 01 00 00 00 00 04 90 00 00 20 /* 249 */
			39 01 00 00 00 00 04 90 00 00 1D /* 250 */
			39 01 00 00 00 00 04 90 00 00 1A /* 251 */
			39 01 00 00 00 00 04 90 00 00 17 /* 252 */
			39 01 00 00 00 00 04 90 00 00 14 /* 253 */
			39 01 00 00 00 00 04 90 00 00 11 /* 254 */
			39 01 00 00 00 00 04 90 00 00 0E /* 255 */
		];

		/*
		 * ************************************************************************************************************************
		* ACL command list and mappings
		 * ************************************************************************************************************************
		 */
		samsung,acl_on_tx_cmds_revA = [
			15 01 00 00 00 00 02 B0 4D		/* Global Para 77th */
			39 01 00 00 00 00 02 B2 05		/* 32 Frame Avg at ACL on */
			15 01 00 00 00 00 02 B0 49		/* Global Para 73th */
			39 01 00 00 00 00 02 B2 99		/* Start setting: 60% start */
			15 01 00 00 00 00 02 B0 36		/* Global Para 54th */
			39 01 00 00 00 00 02 B2 12		/* ACL 15% on */
		]; /* ACL on, B2 <- 0x05 */

		samsung,acl_off_tx_cmds_revA = [
			15 01 00 00 00 00 02 B0 4D		/* Global Para 77th */
			39 01 00 00 00 00 02 B2 04		/* 16 Frame Avg at ACL off */
			15 01 00 00 00 00 02 B0 49		/* Global Para 73th */
			39 01 00 00 00 00 02 B2 99		/* Start setting: 60% start */
			15 01 00 00 00 00 02 B0 36		/* Global Para 54th */
			39 01 00 00 00 00 02 B2 10		/* ACL off */
		];/* ACL off, B2 <- 0x04 */

		/*
		 * ************************************************************************************************************************
		* ELVSS(ACL Off) command list and mappings
		 * ************************************************************************************************************************
		 */
		/* 0xB2 address 103rd parameter value*/
		samsung,elvss_pre_tx_cmds_revA = [15 01 00 00 00 00 02 B0 67]; /* 0x67 : 103rd Para  */
		samsung,elvss_tx_cmds_revA = [
			39 01 00 00 00 00 02 B2 0C
		];

		/*
		 * ************************************************************************************************************************
		 * candela to index mappings
		 * ************************************************************************************************************************
		 */
		samsung,candela_map_table_revA = <
		/*<idx>   <from>  <till> <candella> */
			0	0	0	2
			1       1	1       3
			2       2	2       4
			3       3	3       5
			4       4	4       6
			5       5	5       7
			6       6	6       8
			7       7	7       9
			8       8	8       10
			9       9	9       11
			10	10	10      12
			11	11	11      13
			12	12	12      14
			13	13	13      15
			14	14	14      16
			15	15	15      17
			16	16	16      19
			17	17	17      20
			18	18	18      21
			19	19	19      22
			20	20	20      24
			21	21	21      25
			22	22	23      27
			23	24	25      29
			24	26	27      30
			25	28	29      32
			26	30	31      34
			27	32	33      37
			28	34	35      39
			29	36	37      41
			30	38	39      44
			31	40	41      47
			32	42	43      50
			33	44	45      53
			34	46	48      56
			35	49	51      60
			36	52	54      64
			37	55	57      68
			38	58	60      72
			39	61	63      77
			40	64	66      82
			41	67	69      87
			42	70	72      93
			43	73	76      98
			44	77	80      105
			45	81	86      111
			46	87	91      119
			47	92	97      126
			48	98	104	134
			49	105	110	143
			50	111	118	152
			51	119	125	162
			52	126	133	172
			53	134	142	183
			54	143	150	195
			55	151	160	207
			56	161	170	220
			57	171	181	234
			58	182	192	249
			59	193	203	265
			60	204	214	282
			61	215	225	300
			62	226	235	316
			63	236	245	333
			64	246	255	360
		>;

		samsung,hbm_candela_map_table_revA = <
			0	268	279	378	6
			1	280	292	395	7
			2	293	304	413	8
			3	305	317	430	9
			4	318	329	448	10
			5	330	341	465	11
			6	342	354	483	12
			7	355	355	500	13
		>;

		samsung,pac_candela_map_table_revA = <
		/*
			Please check "config_screenBrightnessSettingMaximum" value at display_config.xml
		 	max vaul is config_screenBrightnessSettingMaximum * 100
		*/
		/* <scaled idx> <idx>  <from>  <end> <cd> <interpolation cd>*/
			0	0	0	0	2	2
			1	1	1	100	3	3
			2	2	101	200	4	4
			3	3	201	300	5	5
			4	4	301	400	6	6
			5	5	401	500	7	7
			6	6	501	600	8	8
			7	7	601	700	9	9
			8	8	701	800	10	10
			9	9	801	900	11	11
			10	10	901	1000	12	12
			11	11	1001	1100	13	13
			12	12	1101	1200	14	14
			13	13	1201	1300	15	15
			14	14	1301	1400	16	16
			15	15	1401	1500	17	17
			16	16	1501	1600	19	19
			17	17	1601	1700	20	20
			18	18	1701	1800	21	21
			19	19	1801	1900	22	22
			20	20	1901	2000	24	24
			21	21	2001	2100	25	25
			22	22	2101	2200	27	26
			23	22	2201	2300	27	27
			24	23	2301	2400	29	28
			25	23	2401	2500	29	29
			26	24	2501	2600	30	30
			27	24	2601	2700	30	30
			28	25	2701	2800	32	31
			29	25	2801	2900	32	32
			30	26	2901	3000	34	33
			31	26	3001	3100	34	34
			32	27	3101	3200	37	36
			33	27	3201	3300	37	37
			34	28	3301	3400	39	38
			35	28	3401	3500	39	39
			36	29	3501	3600	41	40
			37	29	3601	3700	41	41
			38	30	3701	3800	44	43
			39	30	3801	3900	44	44
			40	31	3901	4000	47	46
			41	31	4001	4100	47	47
			42	32	4101	4200	50	49
			43	32	4201	4300	50	50
			44	33	4301	4400	53	52
			45	33	4401	4500	53	53
			46	34	4501	4600	56	54
			47	34	4601	4700	56	55
			48	34	4701	4800	56	56
			49	35	4801	4900	60	57
			50	35	4901	5000	60	59
			51	35	5001	5100	60	60
			52	36	5101	5200	64	61
			53	36	5201	5300	64	63
			54	36	5301	5400	64	64
			55	37	5401	5500	68	65
			56	37	5501	5600	68	67
			57	37	5601	5700	68	68
			58	38	5701	5800	72	69
			59	38	5801	5900	72	71
			60	38	5901	6000	72	72
			61	39	6001	6100	77	74
			62	39	6101	6200	77	75
			63	39	6201	6300	77	77
			64	40	6301	6400	82	79
			65	40	6401	6500	82	80
			66	40	6501	6600	82	82
			67	41	6601	6700	87	84
			68	41	6701	6800	87	85
			69	41	6801	6900	87	87
			70	42	6901	7000	93	89
			71	42	7001	7100	93	91
			72	42	7101	7200	93	93
			73	43	7201	7300	98	94
			74	43	7301	7400	98	96
			75	43	7401	7500	98	97
			76	43	7501	7600	98	98
			77	44	7601	7700	105	100
			78	44	7701	7800	105	102
			79	44	7801	7900	105	103
			80	44	7901	8000	105	105
			81	45	8001	8100	111	106
			82	45	8101	8200	111	107
			83	45	8201	8300	111	108
			84	45	8301	8400	111	109
			85	45	8401	8500	111	110
			86	45	8501	8600	111	111
			87	46	8601	8700	119	113
			88	46	8701	8800	119	114
			89	46	8801	8900	119	116
			90	46	8901	9000	119	117
			91	46	9001	9100	119	119
			92	47	9101	9200	126	120
			93	47	9201	9300	126	121
			94	47	9301	9400	126	123
			95	47	9401	9500	126	124
			96	47	9501	9600	126	125
			97	47	9601	9700	126	126
			98	48	9701	9800	134	127
			99	48	9801	9900	134	128
			100	48	9901	10000	134	129
			101	48	10001	10100	134	131
			102	48	10101	10200	134	132
			103	48	10201	10300	134	133
			104	48	10301	10400	134	134
			105	49	10401	10500	143	136
			106	49	10501	10600	143	137
			107	49	10601	10700	143	139
			108	49	10701	10800	143	140
			109	49	10801	10900	143	142
			110	49	10901	11000	143	143
			111	50	11001	11100	152	144
			112	50	11101	11200	152	145
			113	50	11201	11300	152	146
			114	50	11301	11400	152	148
			115	50	11401	11500	152	149
			116	50	11501	11600	152	150
			117	50	11601	11700	152	151
			118	50	11701	11800	152	152
			119	51	11801	11900	162	153
			120	51	11901	12000	162	155
			121	51	12001	12100	162	156
			122	51	12101	12200	162	158
			123	51	12201	12300	162	159
			124	51	12301	12400	162	161
			125	51	12401	12500	162	162
			126	52	12501	12600	172	163
			127	52	12601	12700	172	165
			128	52	12701	12800	172	166
			129	52	12801	12900	172	167
			130	52	12901	13000	172	168
			131	52	13001	13100	172	170
			132	52	13101	13200	172	171
			133	52	13201	13300	172	172
			134	53	13301	13400	183	173
			135	53	13401	13500	183	174
			136	53	13501	13600	183	176
			137	53	13601	13700	183	177
			138	53	13701	13800	183	178
			139	53	13801	13900	183	179
			140	53	13901	14000	183	181
			141	53	14001	14100	183	182
			142	53	14101	14200	183	183
			143	54	14201	14300	195	185
			144	54	14301	14400	195	186
			145	54	14401	14500	195	188
			146	54	14501	14600	195	189
			147	54	14601	14700	195	191
			148	54	14701	14800	195	192
			149	54	14801	14900	195	194
			150	54	14901	15000	195	195
			151	55	15001	15100	207	196
			152	55	15101	15200	207	197
			153	55	15201	15300	207	199
			154	55	15301	15400	207	200
			155	55	15401	15500	207	201
			156	55	15501	15600	207	202
			157	55	15601	15700	207	203
			158	55	15701	15800	207	205
			159	55	15801	15900	207	206
			160	55	15901	16000	207	207
			161	56	16001	16100	220	208
			162	56	16101	16200	220	210
			163	56	16201	16300	220	211
			164	56	16301	16400	220	212
			165	56	16401	16500	220	214
			166	56	16501	16600	220	215
			167	56	16601	16700	220	216
			168	56	16701	16800	220	217
			169	56	16801	16900	220	219
			170	56	16901	17000	220	220
			171	57	17001	17100	234	221
			172	57	17101	17200	234	223
			173	57	17201	17300	234	224
			174	57	17301	17400	234	225
			175	57	17401	17500	234	226
			176	57	17501	17600	234	228
			177	57	17601	17700	234	229
			178	57	17701	17800	234	230
			179	57	17801	17900	234	231
			180	57	17901	18000	234	233
			181	57	18001	18100	234	234
			182	58	18101	18200	249	235
			183	58	18201	18300	249	237
			184	58	18301	18400	249	238
			185	58	18401	18500	249	239
			186	58	18501	18600	249	241
			187	58	18601	18700	249	242
			188	58	18701	18800	249	244
			189	58	18801	18900	249	245
			190	58	18901	19000	249	246
			191	58	19001	19100	249	248
			192	58	19101	19200	249	249
			193	59	19201	19300	265	250
			194	59	19301	19400	265	252
			195	59	19401	19500	265	253
			196	59	19501	19600	265	255
			197	59	19601	19700	265	256
			198	59	19701	19800	265	258
			199	59	19801	19900	265	259
			200	59	19901	20000	265	261
			201	59	20001	20100	265	262
			202	59	20101	20200	265	264
			203	59	20201	20300	265	265
			204	60	20301	20400	282	267
			205	60	20401	20500	282	268
			206	60	20501	20600	282	270
			207	60	20601	20700	282	271
			208	60	20701	20800	282	273
			209	60	20801	20900	282	274
			210	60	20901	21000	282	276
			211	60	21001	21100	282	277
			212	60	21101	21200	282	279
			213	60	21201	21300	282	280
			214	60	21301	21400	282	282
			215	61	21401	21500	300	284
			216	61	21501	21600	300	285
			217	61	21601	21700	300	287
			218	61	21701	21800	300	289
			219	61	21801	21900	300	290
			220	61	21901	22000	300	292
			221	61	22001	22100	300	293
			222	61	22101	22200	300	295
			223	61	22201	22300	300	297
			224	61	22301	22400	300	298
			225	61	22401	22500	300	300
			226	62	22501	22600	316	302
			227	62	22601	22700	316	303
			228	62	22701	22800	316	305
			229	62	22801	22900	316	306
			230	62	22901	23000	316	308
			231	62	23001	23100	316	310
			232	62	23101	23200	316	311
			233	62	23201	23300	316	313
			234	62	23301	23400	316	314
			235	62	23401	23500	316	316
			236	63	23501	23600	333	318
			237	63	23601	23700	333	319
			238	63	23701	23800	333	321
			239	63	23801	23900	333	323
			240	63	23901	24000	333	325
			241	63	24001	24100	333	326
			242	63	24101	24200	333	328
			243	63	24201	24300	333	330
			244	63	24301	24400	333	331
			245	63	24401	24500	333	333
			246	64	24501	24600	360	336
			247	64	24601	24700	360	338
			248	64	24701	24800	360	341
			249	64	24801	24900	360	344
			250	64	24901	25000	360	347
			251	64	25001	25100	360	349
			252	64	25101	25200	360	352
			253	64	25201	25300	360	355
			254	64	25301	25400	360	357
			255	64	25401	25500	360	360
		>;

		samsung,pac_hbm_candela_map_table_revA = <
			0	26800	27900	378	6
			1	27901	29200	395	7
			2	29201	30400	413	8
			3	30401	31700	430	9
			4	31701	32900	448	10
			5	32901	34100	465	11
			6	34101	35400	483	12
			7	35401	35500	500	13
		>;

		/*
		* ************************************************************************************************************************
		* MULTI_RESOLUTION (DSC configs were moved all to below timing set)
		* (C10P does not support MULTI_RESOLUTION, only FHD.)
		* ************************************************************************************************************************
		*/

		qcom,mdss-dsi-display-timings {
			fhd {
				qcom,display-topology = <2 0 2>;
				qcom,default-topology-index = <0>;

				qcom,mdss-dsi-timing-default;

				qcom,mdss-dsi-panel-width = <1280>; // 2560/2
				qcom,mdss-dsi-panel-height = <1600>;
				qcom,mdss-dsi-t-clk-pre = <0x2F>;
				qcom,mdss-dsi-t-clk-post = <0x0D>;
				qcom,mdss-dsi-panel-phy-timings = [00 1E 08 08 24 22 08 08 05 03 04 00 19 18];
				qcom,mdss-dsi-panel-framerate = <60>;
				qcom,mdss-dsi-panel-clockrate = <898000000>;
				qcom,mdss-dsi-h-pulse-width = <42>;
				qcom,mdss-dsi-h-back-porch = <110>;
				qcom,mdss-dsi-h-front-porch = <110>;
				qcom,mdss-dsi-h-sync-skew = <0>;
				qcom,mdss-dsi-v-pulse-width = <2>;
				qcom,mdss-dsi-v-back-porch = <6>;
				qcom,mdss-dsi-v-front-porch = <10>;

				/*qcom,mdss-dsi-timing-switch-command; use samsung,panel_multires_XXX instead*/
				/*qcom,mdss-dsi-timing-switch-command-state;*/

				qcom,mdss-dsi-on-command= [
					/* Common Setting */
					15 01 00 00 00 00 02 B0 7F		/* Global Para 127th */
					39 01 00 00 00 00 02 B2 15		/* TSP_HTE, TSP_VTE Setting */

					15 01 00 00 00 00 02 B0 BC
					39 01 00 00 00 00 02 B2 04		/* Cange Gamma Offset index */

					39 01 00 00 00 00 22 83			/* Brightness condition set */
						80 80
						80 80
						80 80
						80 00
						80 80
						00
						80 80
						80 80
						80 80
						80 00
						80 80
						00
						80 80
						80 80
						80 80
						80 00
						80 80
						00

					39 01 00 00 00 00 04 90 00 00 0E	/* AID 360 nit */

					15 01 00 00 00 00 02 B0 67		/* Global Para 103rd */
					39 01 00 00 00 00 02 B2 0F		/* 360 nit ELVSS */

					15 01 00 00 00 00 02 B0 4D		/* Global Para 77th */
					39 01 00 00 00 00 02 B2 04		/* 16 Frame Avg at ACL off */

					15 01 00 00 00 00 02 B0 49		/* Global Para 73rd */
					39 01 00 00 00 00 02 B2 99		/* 60% Start  */

					15 01 00 00 00 00 02 B0 36		/* Global Para 54th */
					39 01 00 00 00 00 02 B2 10		/* ACL off */

					15 01 00 00 00 00 02 B0 35		/* Global Para 53rd */
					39 01 00 00 00 00 02 B2 01		/* Gamma Update + Wait 220ms (Panel Spec) */

					/*
						Display On (29h) Command should be transferred after 220ms from TCON_RDY (L'H)
						Please check "samsung,wait_after_sleep_out_delay = <220>;"

					*/
					//05 01 00 00 00 00 02 29 00		/* Display on */
				];

				qcom,mdss-dsi-off-command=[
					05 01 00 00 64 00 02 28 00		/* Display Off + Wait 100ms */
				];

				qcom,mdss-dsi-on-command-state = "dsi_hs_mode";
				qcom,mdss-dsi-off-command-state = "dsi_hs_mode";
			};
		};
	};
};
